## firmware/tests/buffer/testcase.yaml
```yaml
# Twister discovers this suite and runs it on the host via native_sim.
tests:
  kuuki_pod.buffer:
    platform_allow:
      - native_sim
    integration_platforms:
      - native_sim
    tags:
      - buffer
```

## firmware/tests/live/testcase.yaml
```yaml
# Twister discovers this suite and runs it on the host via native_sim.
tests:
  kuuki_pod.live:
    platform_allow:
      - native_sim
    integration_platforms:
      - native_sim
    tags:
      - live
```

## firmware/tests/measurement/testcase.yaml
```yaml
# Twister discovers this suite and runs it on the host via native_sim.
tests:
  kuuki_pod.measurement:
    platform_allow:
      - native_sim
    integration_platforms:
      - native_sim
    tags:
      - measurement
```

## firmware/tests/sync/testcase.yaml
```yaml
# Twister discovers this suite and runs it on the host via native_sim.
tests:
  kuuki_pod.sync:
    platform_allow:
      - native_sim
    integration_platforms:
      - native_sim
    tags:
      - sync
```
